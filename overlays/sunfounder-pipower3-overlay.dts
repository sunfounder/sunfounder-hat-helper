/dts-v1/;
/plugin/;

/ {
    compatible = "brcm,bcm2835";

    fragment@0 {
        target = <&chosen>;
        __overlay__ {
            power {
                max_current = <5000>;
            };
        };
    };
    fragment@1 {
        target = <&i2c1>;
        __overlay__ {
            status = "okay";
        };
    };

};